## firmware/sdkconfig.defaults
```kconfig
# USB Host support
CONFIG_USB_OTG_SUPPORTED=y
CONFIG_USB_HOST_CONTROL_TRANSFER_MAX_SIZE=1024
CONFIG_USB_HOST_HW_BUFFER_BIAS_BALANCED=y

# FreeRTOS - larger stacks for USB tasks
CONFIG_FREERTOS_HZ=1000
CONFIG_ESP_MAIN_TASK_STACK_SIZE=4096

# Disable console UART — UART0 is used by serial bridge protocol at 2 Mbps
CONFIG_ESP_CONSOLE_NONE=y

# Logging
CONFIG_LOG_DEFAULT_LEVEL_INFO=y
CONFIG_LOG_MAXIMUM_LEVEL_DEBUG=y
```
